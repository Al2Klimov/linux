## Documentation/devicetree/bindings/arm/altera.yaml
```yaml
# SPDX-License-Identifier: GPL-2.0
%YAML 1.2
---
$id: https://www.devicetree.org/schemas/arm/altera.yaml#
$schema: https://www.devicetree.org/meta-schemas/core.yaml#

title: Altera's SoCFPGA platform device tree bindings

maintainers:
  - Dinh Nguyen <dinguyen@kernel.org>

properties:
  compatible:
    items:
      - enum:
        - altr,socfpga-cyclone5
        - altr,socfpga-arria5
        - altr,socfpga-arria10
      - const: altr,socfpga
...
```

## Documentation/devicetree/bindings/arm/altera/socfpga-clk-manager.yaml
```yaml
# SPDX-License-Identifier: GPL-2.0
%YAML 1.2
---
$id: https://www.devicetree.org/schemas/arm/altera/socfpga-clk-manager.yaml#
$schema: https://www.devicetree.org/meta-schemas/core.yaml#

title: Altera SOCFPGA Clock Manager

maintainers:
  - Dinh Nguyen <dinguyen@kernel.org>

description: test

properties:
  compatible:
    items:
      - const: altr,clk-mgr
  reg:
    maxItems: 1

required:
  - compatible

additionalProperties: false

examples:
  - |
    clkmgr@ffd04000 {
      compatible = "altr,clk-mgr";
      reg = <0xffd04000 0x1000>;
    };

...
```

## Documentation/devicetree/bindings/arm/bcm/brcm,bcm11351.yaml
```yaml
# SPDX-License-Identifier: GPL-2.0
%YAML 1.2
---
$id: https://www.devicetree.org/schemas/arm/bcm/brcm,bcm11351.yaml#
$schema: https://www.devicetree.org/meta-schemas/core.yaml#

title: Broadcom BCM11351 device tree bindings

maintainers:
  - Florian Fainelli <f.fainelli@gmail.com>

properties:
  $nodename:
    const: '/'
  compatible:
    items:
      - enum:
        - brcm,bcm28155-ap
      - const: brcm,bcm11351

...
```

## Documentation/devicetree/bindings/arm/bcm/brcm,bcm23550.yaml
```yaml
# SPDX-License-Identifier: GPL-2.0
%YAML 1.2
---
$id: https://www.devicetree.org/schemas/arm/bcm/brcm,bcm23550.yaml#
$schema: https://www.devicetree.org/meta-schemas/core.yaml#

title: Broadcom BCM23550 device tree bindings

maintainers:
  - Florian Fainelli <f.fainelli@gmail.com>

properties:
  $nodename:
    const: '/'
  compatible:
    items:
      - enum:
        - brcm,bcm23550-sparrow
      - const: brcm,bcm23550

...
```

## Documentation/devicetree/bindings/arm/bcm/brcm,vulcan-soc.yaml
```yaml
# SPDX-License-Identifier: GPL-2.0
%YAML 1.2
---
$id: https://www.devicetree.org/schemas/arm/bcm/brcm,vulcan-soc.yaml#
$schema: https://www.devicetree.org/meta-schemas/core.yaml#

title: Broadcom Vulcan device tree bindings

maintainers:
  - Robert Richter <rrichter@marvell.com>

properties:
  $nodename:
    const: '/'
  compatible:
    items:
      - enum:
        - brcm,vulcan-eval
        - cavium,thunderx2-cn9900
      - const: brcm,vulcan-soc

...
```

## Documentation/devicetree/bindings/arm/digicolor.yaml
```yaml
# SPDX-License-Identifier: GPL-2.0
%YAML 1.2
---
$id: https://www.devicetree.org/schemas/arm/digicolor.yaml#
$schema: https://www.devicetree.org/meta-schemas/core.yaml#

title: Conexant Digicolor Platforms Device Tree Bindings

maintainers:
  - Baruch Siach <baruch@tkos.co.il>

properties:
  compatible:
    const: cnxt,cx92755

...
```

## Documentation/devicetree/bindings/arm/intel-ixp4xx.yaml
```yaml
# SPDX-License-Identifier: GPL-2.0
%YAML 1.2
---
$id: https://www.devicetree.org/schemas/arm/intel-ixp4xx.yaml#
$schema: https://www.devicetree.org/meta-schemas/core.yaml#

title: Intel IXP4xx Device Tree Bindings

maintainers:
  - Linus Walleij <linus.walleij@linaro.org>

properties:
  compatible:
    oneOf:
      - items:
          - enum:
              - linksys,nslu2
          - const: intel,ixp42x
      - items:
          - enum:
              - gateworks,gw2358
          - const: intel,ixp43x
```

## Documentation/devicetree/bindings/arm/nxp/lpc32xx.yaml
```yaml
# SPDX-License-Identifier: GPL-2.0
%YAML 1.2
---
$id: https://www.devicetree.org/schemas/arm/nxp/lpc32xx.yaml#
$schema: https://www.devicetree.org/meta-schemas/core.yaml#

title: NXP LPC32xx Platforms Device Tree Bindings

maintainers:
  - Roland Stigge <stigge@antcom.de>

properties:
  compatible:
    oneOf:
      - enum:
          - nxp,lpc3220
          - nxp,lpc3230
          - nxp,lpc3240
      - items:
        - enum:
            - ea,ea3250
            - phytec,phy3250
        - const: nxp,lpc3250

...
```

## Documentation/devicetree/bindings/arm/socionext/milbeaut.yaml
```yaml
# SPDX-License-Identifier: GPL-2.0
%YAML 1.2
---
$id: https://www.devicetree.org/schemas/arm/socionext/milbeaut.yaml#
$schema: https://www.devicetree.org/meta-schemas/core.yaml#

title: Milbeaut platforms device tree bindings

maintainers:
  - Taichi Sugaya <sugaya.taichi@socionext.com>
  - Takao Orito <orito.takao@socionext.com>

properties:
  $nodename:
    const: '/'
  compatible:
    oneOf:
      - items:
          - enum:
              - socionext,milbeaut-m10v-evb
          - const: socionext,sc2000a
...
```

## Documentation/devicetree/bindings/arm/sti.yaml
```yaml
# SPDX-License-Identifier: GPL-2.0
%YAML 1.2
---
$id: https://www.devicetree.org/schemas/arm/sti.yaml#
$schema: https://www.devicetree.org/meta-schemas/core.yaml#

title: ST STi Platforms Device Tree Bindings

maintainers:
  - Patrice Chotard <patrice.chotard@st.com>

properties:
  $nodename:
    const: '/'
  compatible:
    items:
      - enum:
          - st,stih415
          - st,stih416
          - st,stih407
          - st,stih410
          - st,stih418
...
```

## Documentation/devicetree/bindings/arm/vt8500.yaml
```yaml
# SPDX-License-Identifier: GPL-2.0
%YAML 1.2
---
$id: https://www.devicetree.org/schemas/arm/vt8500.yaml#
$schema: https://www.devicetree.org/meta-schemas/core.yaml#

title: VIA/Wondermedia VT8500 Platforms Device Tree Bindings

maintainers:
  - Tony Prisk <linux@prisktech.co.nz>
description: test

properties:
  $nodename:
    const: '/'
  compatible:
    items:
      - enum:
          - via,vt8500
          - wm,wm8505
          - wm,wm8650
          - wm,wm8750
          - wm,wm8850
```

## Documentation/devicetree/bindings/iio/chemical/sensirion,sps30.yaml
```yaml
# SPDX-License-Identifier: GPL-2.0
%YAML 1.2
---
$id: https://www.devicetree.org/schemas/iio/chemical/sensirion,sps30.yaml#
$schema: https://www.devicetree.org/meta-schemas/core.yaml#

title: Sensirion SPS30 particulate matter sensor

maintainers:
  - Tomasz Duszynski <tduszyns@gmail.com>

description: |
  Air pollution sensor capable of measuring mass concentration of dust
  particles.

properties:
  compatible:
    enum:
      - sensirion,sps30
  reg:
    maxItems: 1

required:
  - compatible
  - reg

additionalProperties: false

examples:
  - |
    i2c {
      #address-cells = <1>;
      #size-cells = <0>;

      air-pollution-sensor@69 {
        compatible = "sensirion,sps30";
        reg = <0x69>;
      };
    };

...
```
